## extra-module/Kconfig
```kconfig
# Copyright (c) 2026
# SPDX-License-Identifier: MIT

rsource "drivers/kscan/Kconfig"
```

## extra-module/battery_led/Kconfig
```kconfig
# Copyright (c) 2026
# SPDX-License-Identifier: MIT

config ZMK_BATTERY_LED
    bool "Battery level LED indicator (independent WS2812 chain)"
    default y
    select LED_STRIP
```

## extra-module/ble_led/Kconfig
```kconfig
# Copyright (c) 2026
# SPDX-License-Identifier: MIT

config ZMK_BLE_LED
    bool "Bluetooth connection status LED (GPIO direct drive)"
    default y
    select GPIO
```

## extra-module/drivers/kscan/Kconfig
```kconfig
# Copyright (c) 2026
# SPDX-License-Identifier: MIT

DT_COMPAT_ZMK_KSCAN_GPIO_AI32C := zmk,kscan-gpio-ai32c

if KSCAN

config ZMK_KSCAN_GPIO_AI32C
    bool "AI32C GPIO KSCAN driver"
    default $(dt_compat_enabled,$(DT_COMPAT_ZMK_KSCAN_GPIO_AI32C))
    select GPIO

endif # KSCAN
```

## extra-module/dts/bindings/zmk,kscan-gpio-ai32c.yaml
```yaml
# Copyright (c) 2026
# SPDX-License-Identifier: MIT

description: AI32C capacitive touch kscan driver (3-key, 2-wire encoded)

compatible: "zmk,kscan-gpio-ai32c"

include: kscan.yaml

properties:
  out-gpios:
    type: phandle-array
    required: true
    description: |
      Two GPIOs connected to AI32C OUT1 and OUT2.
      OUT1 = index 0, OUT2 = index 1.
      AI32C OUT is push-pull; the driver forces plain GPIO inputs
      (dt flags are ignored, no pull-up needed).
      Encoding (OUT1,OUT2): 11=idle, 00=KEY1, 10=KEY2, 01=KEY3.
```
